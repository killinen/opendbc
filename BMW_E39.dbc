VERSION ""

NS_ :

BS_:

BU_: XXX

BO_ 339 ASC_1: 8 XXX

BO_ 501 SZL_1: 8 XXX
 SG_ NEW_SIGNAL_1 : 7|16@0+ (0.045,0) [0|1] "" XXX
 SG_ NEW_SIGNAL_2 : 23|16@0+ (0.045,0) [0|1] "" XXX

BO_ 790 DME_1: 8 XXX

BO_ 809 DME_2: 8 XXX
 SG_ THROTTLE_POSITION : 47|8@0+ (1,0) [0|1] "" XXX

BO_ 1349 DME_3: 8 XXX

BO_ 1555 IKE_1: 8 XXX

BO_ 1557 IKE_2: 8 XXX

BO_ 496 ABS_1: 8 XXX

BO_ 499 STEERING_ANGLE_SENSOR: 8 XXX
 SG_ ACTUAL_STEERING_ANGLE : 47|8@0+ (0.045,-5.8) [0|1] "" XXX
